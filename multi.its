## multi.its
```
/dts-v1/;

/ {
    description = "Various kernels and ramdisks blobs";
    #address-cells = <2>;

    images {
        kernel-1 {
            description = "vmlinux";
            data = /incbin/("build/vmlinux.bin");
            type = "kernel";
            arch = "loongarch";
            os = "linux";
            compression = "none";
            load = <0x90000000 0x00200000>;
            entry = <0x90000000 0x00daf000>;
                                
            hash-1 {
                algo = "sha1";
            };
        };
    }; /* images 节点在此闭合 */

    configurations {
        default = "config-1";
        config-1 {
            description = "build by wjjsn";
            kernel = "kernel-1";
        };
    };
};
```
